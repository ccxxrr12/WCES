## competition/firmware/esp32-c5-csi-node/sdkconfig.defaults.template
```kconfig
# ESP32-C5 CSI Node — Default SDK Configuration (Template)
# Copy to sdkconfig.defaults and customize before building.
# This file is applied automatically by idf.py when no sdkconfig exists.
#
# ESP-IDF v5.5+ required for full C5 CSI support (v5.4 has 5GHz CSI cache bug).

# Target: ESP32-C5 (RISC-V, WiFi 6)
CONFIG_IDF_TARGET="esp32c5"

# Use custom partition table (8MB flash with OTA — ADR-045)
CONFIG_PARTITION_TABLE_CUSTOM=y
CONFIG_PARTITION_TABLE_CUSTOM_FILENAME="partitions_display.csv"

# Flash configuration: 8MB (Quad SPI)
CONFIG_ESPTOOLPY_FLASHSIZE_8MB=y
CONFIG_ESPTOOLPY_FLASHSIZE="8MB"

# Compiler optimization: optimize for size
CONFIG_COMPILER_OPTIMIZATION_SIZE=y

# Enable CSI (Channel State Information) in WiFi driver
# C5 uses new CSI config API (.acquire_csi_*) — different from S3 (.lltf_en)
CONFIG_ESP_WIFI_CSI_ENABLED=y

# Disable unused features to reduce binary size
CONFIG_BOOTLOADER_LOG_LEVEL_WARN=y
CONFIG_LOG_DEFAULT_LEVEL_INFO=y

# LWIP: enable extended socket options for UDP multicast
CONFIG_LWIP_SO_RCVBUF=y

# FreeRTOS: task stack for CSI processing (C5 has 400KB SRAM)
CONFIG_ESP_MAIN_TASK_STACK_SIZE=7168

# C5: Disable display by default (GPIO pins differ from S3)
# CONFIG_DISPLAY_ENABLE is not set
```

## firmware/esp32-c5-csi-node/sdkconfig.defaults.4mb
```kconfig
# ESP32-C5 CSI Node — 4MB Flash SDK Configuration
# For C5 boards with 4MB flash.
#
# Build: cp sdkconfig.defaults.4mb sdkconfig.defaults && idf.py set-target esp32c5 && idf.py build
# Or:    idf.py -D SDKCONFIG_DEFAULTS="sdkconfig.defaults.4mb" set-target esp32c5 && idf.py build

CONFIG_IDF_TARGET="esp32c5"

# 4MB flash partition table
CONFIG_PARTITION_TABLE_CUSTOM=y
CONFIG_PARTITION_TABLE_CUSTOM_FILENAME="partitions_4mb.csv"
CONFIG_ESPTOOLPY_FLASHSIZE_4MB=y
CONFIG_ESPTOOLPY_FLASHSIZE="4MB"

# Compiler: optimize for size (critical for 4MB)
CONFIG_COMPILER_OPTIMIZATION_SIZE=y

# CSI support (C5 uses new .acquire_csi_* API)
CONFIG_ESP_WIFI_CSI_ENABLED=y

# Disable display support to save flash
# CONFIG_DISPLAY_ENABLE is not set

# Reduce logging to save flash
CONFIG_BOOTLOADER_LOG_LEVEL_WARN=y
CONFIG_LOG_DEFAULT_LEVEL_INFO=y

CONFIG_LWIP_SO_RCVBUF=y
CONFIG_ESP_MAIN_TASK_STACK_SIZE=7168
```

## firmware/esp32-c5-csi-node/sdkconfig.defaults.competition
```kconfig
# ESP32-C5 CSI Node — 竞赛现场配置
# 固定 WiFi + 高性能 CSI, 3 节点预配置
#
# 使用方法 (每个节点 flash 前修改 CONFIG_CSI_NODE_ID):
#   cp sdkconfig.defaults.competition sdkconfig.defaults
#   修改 CONFIG_CSI_NODE_ID=1 (或 2, 3)
#   idf.py set-target esp32c5 && idf.py build && idf.py -p COMx flash
#
# 网络拓扑:
#   RZ/V2H 主控:   192.168.1.1    (静态 IP, 千兆路由)
#   ESP32-C5 #1:   192.168.1.10   (SSID: RuView-Triage, 信道 6)
#   ESP32-C5 #2:   192.168.1.11
#   ESP32-C5 #3:   192.168.1.12

# Target
CONFIG_IDF_TARGET="esp32c5"

# WiFi
CONFIG_CSI_WIFI_SSID="RuView-Triage"
CONFIG_CSI_WIFI_PASSWORD="competition2026"
CONFIG_CSI_TARGET_IP="192.168.1.1"
CONFIG_CSI_TARGET_PORT=5005
CONFIG_CSI_WIFI_CHANNEL=6
CONFIG_CSI_NODE_ID=1   # ← 节点 2 改为 2, 节点 3 改为 3

# 分区表 (8MB + OTA)
CONFIG_PARTITION_TABLE_CUSTOM=y
CONFIG_PARTITION_TABLE_CUSTOM_FILENAME="partitions_display.csv"
CONFIG_ESPTOOLPY_FLASHSIZE_8MB=y
CONFIG_ESPTOOLPY_FLASHSIZE="8MB"

# CSI 启用
CONFIG_ESP_WIFI_CSI_ENABLED=y

# 编译优化
CONFIG_COMPILER_OPTIMIZATION_SIZE=y

# 日志 (竞赛现场用 WARN 级别减少串口输出)
CONFIG_BOOTLOADER_LOG_LEVEL_WARN=y
CONFIG_LOG_DEFAULT_LEVEL_WARN=y

# 网络
CONFIG_LWIP_SO_RCVBUF=y

# 内存 (C5 400KB SRAM)
CONFIG_ESP_MAIN_TASK_STACK_SIZE=7168

# 关闭显示 (竞赛用外部触屏连 RZ/V2H)
# CONFIG_DISPLAY_ENABLE is not set

# 关闭 mock CSI (竞赛用真实 CSI)
# CONFIG_CSI_MOCK_ENABLED is not set
```
